## CMakeLists.txt
```
# SPDX-License-Identifier: Apache-2.0

cmake_minimum_required(VERSION 3.13.1)

# For this example, add ZEPHYR_RUST as a zephyr module. Not needed if added in
# your environment or managed by west.
# -> currently set by environment
# get_filename_component(ZEPHYR_RUST ${CMAKE_CURRENT_SOURCE_DIR}/../.. ABSOLUTE)
# list(APPEND ZEPHYR_EXTRA_MODULES ${ZEPHYR_RUST})

include($ENV{ZEPHYR_BASE}/cmake/app/boilerplate.cmake NO_POLICY_SCOPE)
project(spi_fram)
target_sources(app PRIVATE ./src/main.c)
```

## prj.conf
```kconfig
CONFIG_RUST=y
CONFIG_RUST_ALLOC_POOL=y
CONFIG_SERIAL=y
CONFIG_UART_NATIVE_POSIX=y
CONFIG_NATIVE_UART_0_ON_OWN_PTY=y
CONFIG_USERSPACE=y
CONFIG_QEMU_ICOUNT=n
CONFIG_LOG=y

# enable SPI
CONFIG_SPI=y
CONFIG_GPIO=y

# enable cooperative scheduling and disable preemtive scheduling
# CONFIG_NUM_PREEMPT_PRIORITIES=0
```

## src/main.c
```c
/*
 * Copyright (C) 2025  Markus Elias Gerber
 * 
 * This program is free software: you can redistribute it and/or modify
 * it under the terms of the GNU General Public License as published by
 * the Free Software Foundation, either version 3 of the License, or
 * (at your option) any later version.
 *
 * This program is distributed in the hope that it will be useful,
 * but WITHOUT ANY WARRANTY; without even the implied warranty of
 * MERCHANTABILITY or FITNESS FOR A PARTICULAR PURPOSE.  See the
 * GNU General Public License for more details.
 * 
 * You should have received a copy of the GNU General Public License
 * along with this program.  If not, see <https://www.gnu.org/licenses/>.
 */

#include <version.h>
#if KERNEL_VERSION_MAJOR < 3
#include <zephyr.h>
#else
#include <zephyr/kernel.h>
#endif

#include "../../common/atomics/atomics.h"
#include "../../common/spi_fram_storage/include/mb85rs4mt_spi_fram.h"

extern void rust_main(void);

void main(void)
{
	rust_main();
}
```

## src/mb85rs64v_spi_fram.h
```c
#ifndef SPI_FRAM_H
#define SPI_FRAM_H

#include <errno.h>
#include <zephyr/kernel.h>
#include <zephyr/sys/printk.h>
#include <zephyr/device.h>
#include <zephyr/drivers/spi.h>

#define MB85RS64V_MANUFACTURER_ID_CMD 0x9f
#define MB85RS64V_WRITE_ENABLE_CMD 0x06
#define MB85RS64V_READ_CMD 0x03
#define MB85RS64V_WRITE_CMD 0x02

struct spi_dt_spec mb85rs64v_init(int* error) {
	struct spi_config spi_cfg = {
		.frequency = 256000U,
		.operation = SPI_WORD_SET(8),
		.cs = SPI_CS_CONTROL_INIT(DT_NODELABEL(spidev), 10),
	};

	const struct device* device = DEVICE_DT_GET(DT_NODELABEL(spi2));
	if (!device_is_ready(device)) {
		*error = 1;

		struct spi_dt_spec spec = {
			.bus = NULL,
			.config = spi_cfg
		};

		return spec;
	}

	struct spi_dt_spec spec = {
		.bus = device,
		.config = spi_cfg
	};
	
	return spec;
}

static inline int mb85rs64v_access(const struct spi_dt_spec* device,
			    uint8_t cmd, uint16_t addr, void *data, size_t len)
{
	uint8_t access[3];
	struct spi_buf bufs[] = {
		{
			.buf = access,
		},
		{
			.buf = data,
			.len = len
		}
	};
	struct spi_buf_set tx = {
		.buffers = bufs
	};

	access[0] = cmd;

	if (cmd == MB85RS64V_WRITE_CMD || cmd == MB85RS64V_READ_CMD) {
		access[1] = (addr >> 8) & 0xFF;
		access[2] = addr & 0xFF;

		bufs[0].len = 3;
		tx.count = 2;

		if (cmd == MB85RS64V_READ_CMD) {
			struct spi_buf_set rx = {
				.buffers = bufs,
				.count = 2
			};

			return spi_transceive_dt(device, &tx, &rx);
		}
	} else {
		tx.count = 1;
		bufs[0].len = 1;
	}

	return spi_write_dt(device, &tx);
}


int mb85rs64v_validate_id(const struct spi_dt_spec* device)
{
	uint8_t id[4];

	uint8_t cmd = MB85RS64V_MANUFACTURER_ID_CMD;
	struct spi_buf bufs[] = {
		{
			.buf = &cmd,
			.len = 1
		},
		{
			.buf = id,
			.len = sizeof(id)
		}
	};
	struct spi_buf_set tx = {
		.buffers = bufs,
		.count = 1
	};
	struct spi_buf_set rx = {
		.buffers = bufs,
		.count = 2
	};

	int err;
	err = spi_transceive_dt(device, &tx, &rx);

	if (err) {
		return -EIO;
	}

	if (id[0] != 0x04) {
		return -EIO;
	}

	if (id[1] != 0x7f) {
		return -EIO;
	}

	if (id[2] != 0x03) {
		return -EIO;
	}

	if (id[3] != 0x02) {
		return -EIO;
	}

	return 0;
}

int mb85rs64v_write_bytes(const struct spi_dt_spec* device,
		       uint16_t addr, uint8_t *data, uint32_t num_bytes)
{
	int err;

	/* disable write protect */
	err = mb85rs64v_access(device,
			       MB85RS64V_WRITE_ENABLE_CMD, 0, NULL, 0);
	if (err) {
		return -EIO;
	}

	/* write cmd */
	err = mb85rs64v_access(device,
			       MB85RS64V_WRITE_CMD, addr, data, num_bytes);
	if (err) {
		return -EIO;
	}

	return 0;
}

int mb85rs64v_read_bytes(const struct spi_dt_spec* device,
		      uint16_t addr, uint8_t *data, uint32_t num_bytes)
{
	int err;

	/* read cmd */
	err = mb85rs64v_access(device,
			       MB85RS64V_READ_CMD, addr, data, num_bytes);
	if (err) {
		return -EIO;
	}

	return 0;
}

#endif
```
